## Kconfig
```kconfig
# Copyright (c) 2025, The ZMK Contributors
# SPDX-License-Identifier: MIT


# menu "GPIO HOLD Options"
# endmenu

DT_COMPAT_ZMK_BEHAVIOR_GPIO_HOLD := zmk,behavior-gpio-hold

config ZMK_BEHAVIOR_GPIO_HOLD
    bool "GPIO Hold On/Off Behavior"
    default $(dt_compat_enabled,$(DT_COMPAT_ZMK_BEHAVIOR_GPIO_HOLD))
    help
      Enable support for ZMK external gpio control with hold-on/release-off behavior
      This allows press-on/release-off control of switching circuits via dedicated GPIO pins.

if ZMK_BEHAVIOR_GPIO_HOLD

config ZMK_BEHAVIOR_GPIO_HOLD_LOG_LEVEL
    int "Log level for gpio hold behavior"
    default 0
    range 0 4
    help
      0: OFF, 1: ERR, 2: WRN, 3: INF, 4: DBG

endif
```

## dts/bindings/behaviors/zmk,behavior-extpwr-hold.yaml
```yaml
# Copyright (c) 2025, The ZMK Contributors
# SPDX-License-Identifier: MIT

description: |
  ZMK external power hold-on/release-off behavior

compatible: "zmk,behavior-gpio-hold"

include: zero_param.yaml

properties:
  control-gpios:
    type: phandle-array
    description: Optional set of pins that should be set active when pressing.
```

## tests/west.yml
```yaml
manifest:
  version: "0.13"
  remotes:
    - name: zmkfirmware
      url-base: https://github.com/zmkfirmware
  projects:
    - name: zmk
      remote: zmkfirmware
      revision: v0.2.1
      clone-depth: 1
      import:
        file: app/west.yml
  self:
    path: .
```
